## sdkconfig.defaults
```kconfig
# 这个固件**只用蓝牙**：WiFi 关掉，省 flash 和 RAM。
# 蓝牙上不了互联网，所以时间由 PC 通过 BLE 推送（见 src/main.cpp 的 bleOnTime）。
#
# lwIP 不能关：esp-tls 等组件依赖它的 sys/socket.h，关掉会编译失败。
# 没有 netif 在用，它基本只是躺在那儿。
#
# 改这里才会进版本库；sdkconfig.esp32c3-clock 是生成物、已被 .gitignore 排除。

# CONFIG_ESP_WIFI_ENABLED is not set

CONFIG_BT_ENABLED=y
CONFIG_BT_NIMBLE_ENABLED=y

# 只作外设（peripheral + broadcaster）：时钟等 PC 连上来推数据，不主动扫别人。
# 关掉 central/observer 能省一些 RAM。
CONFIG_BT_NIMBLE_ROLE_PERIPHERAL=y
CONFIG_BT_NIMBLE_ROLE_BROADCASTER=y
# CONFIG_BT_NIMBLE_ROLE_CENTRAL is not set
# CONFIG_BT_NIMBLE_ROLE_OBSERVER is not set

CONFIG_BT_NIMBLE_MAX_CONNECTIONS=1

# 247 是 Windows 上常见的协商值。越大，PC 发一段文字要分的块越少。
CONFIG_BT_NIMBLE_ATT_PREFERRED_MTU=247
CONFIG_BT_NIMBLE_HOST_TASK_STACK_SIZE=4096
```
